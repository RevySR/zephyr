## boards/beaglebone/beaglev_ahead/board.yml
```yaml
board:
  name: beaglev_ahead
  full_name: BeagleV Ahead
  vendor: beaglebone
  socs:
    - name: th1520
```

## boards/milkv/milkv_meles/Kconfig.milkv_meles
```kconfig
# SPDX-License-Identifier: Apache-2.0
config BOARD_MILKV_MELES
	select SOC_TH1520
```

## boards/milkv/milkv_meles/board.yml
```yaml
board:
  name: milkv_meles
  full_name: Milk-V Meles
  vendor: milkv
  socs:
    - name: th1520
```

## boards/sipeed/licheepi_4a/Kconfig.licheepi_4a
```kconfig
# SPDX-License-Identifier: Apache-2.0
config BOARD_LICHEEPI_4A
	select SOC_TH1520
```

## boards/sipeed/licheepi_4a/board.yml
```yaml
board:
  name: licheepi_4a
  full_name: Sipeed Lichee Pi 4A
  vendor: sipeed
  socs:
    - name: th1520
```

## boards/thead/light_val_a/Kconfig.light_val_a
```kconfig
# SPDX-License-Identifier: Apache-2.0
config BOARD_LIGHT_VAL_A
	select SOC_TH1520
```

## boards/thead/light_val_a/board.yml
```yaml
board:
  name: light_val_a
  full_name: TH1520 LIGHT validation A
  vendor: thead
  socs:
    - name: th1520
```

## boards/zhihe/melonpi/board.yml
```yaml
board:
  name: melonpi
  full_name: Zhihe Melon Pi
  vendor: zhihe
  socs:
    - name: a210
```

## drivers/clock_control/Kconfig.a210
```kconfig
# SPDX-License-Identifier: Apache-2.0
config CLOCK_CONTROL_A210
	bool "A210 AP clock tree"
	default y
	depends on DT_HAS_ZHIHE_A210_CLOCK_TREE_ENABLED && COUNTER
	help
	  Control the AP clock tree from E902, including shared parent references,
	  synchronized dividers and clock state restoration after domain power loss.

config CLOCK_CONTROL_A210_INIT_PRIORITY
	int "A210 clock tree initialization priority"
	default 90
	depends on CLOCK_CONTROL_A210
```

## drivers/clock_control/Kconfig.xuantie_cpu
```kconfig
# SPDX-License-Identifier: Apache-2.0
config CLOCK_CONTROL_XUANTIE_CPU
	bool "XuanTie CPU DVFS clocks"
	default y
	depends on DT_HAS_ZHIHE_A210_CPU_CLOCK_ENABLED || DT_HAS_THEAD_TH1520_CPU_CLOCK_ENABLED
	depends on REGULATOR && COUNTER && !MULTITHREADING

config CPU_DVFS_INIT_PRIORITY
	int "CPU DVFS initialization priority"
	default 95
	depends on CLOCK_CONTROL_XUANTIE_CPU
```

## drivers/counter/Kconfig.thead_mtime
```kconfig
# SPDX-License-Identifier: Apache-2.0
config COUNTER_THEAD_MTIME
	bool "T-Head E902 machine timer"
	default y
	depends on DT_HAS_THEAD_E902_MTIME_ENABLED
```

## drivers/i2c/Kconfig.dw_poll
```kconfig
# SPDX-License-Identifier: Apache-2.0
config I2C_DW_POLL
	bool "DesignWare polling I2C"
	default y
	depends on DT_HAS_SNPS_DESIGNWARE_I2C_POLL_ENABLED
	depends on RISCV && !MULTITHREADING
	depends on COUNTER
```

## drivers/interrupt_controller/Kconfig.thead_e902
```kconfig
# SPDX-License-Identifier: Apache-2.0
config THEAD_E902_CLIC
	bool "T-Head E902 CLIC"
	default y
	depends on DT_HAS_THEAD_E902_CLIC_ENABLED
```

## drivers/mbox/Kconfig.e902
```kconfig
# SPDX-License-Identifier: Apache-2.0
config MBOX_E902
	bool "E902 AON mailbox (TH1520/A210)"
	default y
	depends on RISCV && !MULTITHREADING
	depends on DT_HAS_THEAD_TH1520_MBOX_ENABLED
	help
	  Serve the signal-only AP channel of the XuanTie AON mailbox
	  interface shared by the TH1520 and A210 AON processors. Both instances use
	  device-tree resources with the same register interface.
```

## drivers/regulator/Kconfig.coupled
```kconfig
# SPDX-License-Identifier: Apache-2.0
config REGULATOR_COUPLED
	bool "coupled driver"
	default y
	depends on !MULTITHREADING
	depends on DT_HAS_ZEPHYR_REGULATOR_COUPLED_ENABLED

config REGULATOR_COUPLED_INIT_PRIORITY
	int
	default 85
```

## drivers/regulator/Kconfig.da9121
```kconfig
# SPDX-License-Identifier: Apache-2.0
config REGULATOR_DA9121
	bool "DA9121 regulator"
	default y
	depends on !MULTITHREADING
	depends on DT_HAS_DLG_DA9121_REGULATOR_ENABLED
	depends on I2C && COUNTER
	select REGULATOR_PMIC_COMMON
	select REGULATOR_PMIC_BACKEND
```

## drivers/regulator/Kconfig.pmic_common
```kconfig
# SPDX-License-Identifier: Apache-2.0
config REGULATOR_PMIC_COMMON
	bool
	depends on I2C && COUNTER

config REGULATOR_PMIC_INIT_PRIORITY
	int
	default 80

config REGULATOR_PMIC_BACKEND
	bool
	depends on REGULATOR_PMIC_COMMON

config REGULATOR_SILERGY
	bool
	depends on REGULATOR_PMIC_COMMON
```

## drivers/regulator/Kconfig.slg51000
```kconfig
# SPDX-License-Identifier: Apache-2.0
config REGULATOR_SLG51000
	bool "SLG51000 regulator"
	default y
	depends on !MULTITHREADING
	depends on DT_HAS_DLG_SLG51000_REGULATOR_ENABLED
	depends on I2C && COUNTER
	select REGULATOR_PMIC_COMMON
	select REGULATOR_PMIC_BACKEND
```

## drivers/regulator/Kconfig.sy70209
```kconfig
# SPDX-License-Identifier: Apache-2.0
config REGULATOR_SY70209
	bool "SY70209 regulator"
	default y
	depends on !MULTITHREADING
	depends on DT_HAS_SILERGY_SY70209_REGULATOR_ENABLED
	depends on I2C && COUNTER
	select REGULATOR_PMIC_COMMON
	select REGULATOR_SILERGY
```

## drivers/regulator/Kconfig.sy70300
```kconfig
# SPDX-License-Identifier: Apache-2.0
config REGULATOR_SY70300
	bool "SY70300 regulator"
	default y
	depends on !MULTITHREADING
	depends on DT_HAS_SILERGY_SY70300_REGULATOR_ENABLED
	depends on I2C && COUNTER
	select REGULATOR_PMIC_COMMON
	select REGULATOR_SILERGY
```

## drivers/reset/Kconfig.a210
```kconfig
# SPDX-License-Identifier: Apache-2.0
config RESET_A210
	bool "A210 AP reset banks"
	default y
	depends on DT_HAS_ZHIHE_A210_RESET_ENABLED
	help
	  Control the A210 AP peripheral reset banks and preserve reset requests
	  while a managed peripheral power domain is off.
```

## drivers/sensor/moortec/Kconfig
```kconfig
# SPDX-License-Identifier: Apache-2.0
config MR75203
	bool "Moortec MR75203 PVT monitor"
	default y
	depends on DT_HAS_MOORTEC_MR75203_ENABLED && COUNTER
	help
	  Read the temperature and voltage channels of the MR75203 PVT monitor.
	  Serial converter transactions use a hardware counter for bounded polling.
```

## dts/bindings/clock/thead,th1520-cpu-clock.yaml
```yaml
# SPDX-License-Identifier: Apache-2.0
description: TH1520 C910 cluster clock and voltage controller
compatible: "thead,th1520-cpu-clock"
include: xuantie-cpu-clock.yaml
```
