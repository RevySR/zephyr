/* SPDX-License-Identifier: Apache-2.0 */
#include <mem.h>

/ {
	#address-cells = <1>;
	#size-cells = <1>;
	cpus {
		#address-cells = <1>;
		#size-cells = <0>;
		cpu0: cpu@0 {
			device_type = "cpu";
			compatible = "riscv";
			reg = <0>;
			riscv,isa-base = "rv32e";
			riscv,isa-extensions = "e", "m", "c", "zicsr", "zifencei";
			mmu-type = "riscv,none";
		};
	};
	clic: interrupt-controller@e0800000 {
		compatible = "thead,e902-clic";
		reg = <0xe0800000 0x10000>;
		interrupt-controller;
		#interrupt-cells = <2>;
	};
};
