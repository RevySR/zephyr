## dts/bindings/clock/xuantie-cpu-clock.yaml
```yaml
# SPDX-License-Identifier: Apache-2.0
description: CPU PLL switching with coordinated regulator operating points
include: [base.yaml, clock-controller.yaml]
properties:
  reg:
    required: true
  reg-names:
    required: true
  "#clock-cells":
    const: 0
  domain-name:
    type: string
    required: true
  cpu-supply:
    type: phandle
    required: true
    description: CPU supply, optionally a coupled regulator group
  cpu-sram-supply:
    type: phandle
    description: Optional independently controlled CPU SRAM supply
  operating-points-v2:
    type: phandle
    required: true
  timeout-counter:
    type: phandle
    required: true
  sustained-frequency-khz:
    type: int
    required: true
    description: Highest non-turbo operating point
  transition-latency-us:
    type: int
    required: true
```

## dts/bindings/clock/zhihe,a210-clock-tree.yaml
```yaml
# SPDX-License-Identifier: Apache-2.0
description: A210 AP clock tree controlled by E902 firmware
compatible: "zhihe,a210-clock-tree"
include: [base.yaml, clock-controller.yaml]
properties:
  reg:
    required: true
  clock-frequency:
    type: int
    required: true
  rtc-frequency:
    type: int
    required: true
  aon-source-frequencies:
    type: array
    required: true
  gpu-status-reg:
    type: int
    required: true
    description: GPU PCU current-state register address
  vo-status-reg:
    type: int
    required: true
    description: VOSYS PCU current-state register address
  timeout-counter:
    type: phandle
    required: true
  zhihe,boot-parents:
    type: array
    description: Pairs of clock and parent IDs selected before the AP starts using SCMI
  zhihe,boot-rates:
    type: array
    description: Pairs of clock IDs and rates in Hz selected before the AP starts using SCMI
  "#clock-cells":
    const: 1
clock-cells:
  - id
```

## dts/bindings/clock/zhihe,a210-cpu-clock.yaml
```yaml
# SPDX-License-Identifier: Apache-2.0
description: A210 C908 or C920 CPU clock and voltage controller
compatible: "zhihe,a210-cpu-clock"
include: xuantie-cpu-clock.yaml
```

## dts/bindings/counter/thead,e902-mtime.yaml
```yaml
# SPDX-License-Identifier: Apache-2.0
description: Read-only low word of the free-running T-Head E902 machine timer
compatible: "thead,e902-mtime"
include: base.yaml
properties:
  reg:
    required: true
  clock-frequency:
    type: int
    required: true
```

## dts/bindings/gpio/silergy,sy70209-gpio.yaml
```yaml
# SPDX-License-Identifier: Apache-2.0
description: SY70209 GPIO outputs, used to describe shared PMIC enable wiring
compatible: "silergy,sy70209-gpio"
include: [base.yaml, gpio-controller.yaml]
properties:
  "#gpio-cells":
    const: 2
gpio-cells:
  - pin
  - flags
```

## dts/bindings/i2c/snps,designware-i2c-poll.yaml
```yaml
# SPDX-License-Identifier: Apache-2.0
description: |
  DesignWare I2C controller used in polling mode with inherited bus timing.
  Boot firmware must establish clock, reset, pinmux and exclusive ownership.
compatible: "snps,designware-i2c-poll"
include: i2c-controller.yaml
properties:
  reg:
    required: true
  timeout-counter:
    type: phandle
    required: true
    description: Free-running counter for bounded transfer deadlines
```

## dts/bindings/interrupt-controller/thead,e902-clic.yaml
```yaml
# SPDX-License-Identifier: Apache-2.0

description: |
  T-Head E902 legacy core-local interrupt controller. CLICCFG, CLICINFO
  and MINTTHRESH are at offsets 0, 4 and 8; CLICCFG.nlbits starts at bit 1.

compatible: "thead,e902-clic"

include: riscv,clic.yaml
```

## dts/bindings/mbox/thead,th1520-mbox.yaml
```yaml
# SPDX-License-Identifier: Apache-2.0
description: |
  XuanTie AON mailbox interface shared by TH1520 and A210 E902 AON processors.
  rx is the local interrupt block; tx is the remote AP data channel.
compatible: "thead,th1520-mbox"
include: [base.yaml, mailbox-controller.yaml]
properties:
  reg:
    required: true
  reg-names:
    required: true
  rx-channel:
    type: int
    required: true
    enum: [0, 1, 2, 3]
    description: Receive status bit assigned to the peer in the local IRQ block
  zhihe,channel-info:
    type: boolean
    description: |
      Provide two transmit channels sharing the peer doorbell. Each doorbell
      first sets INFO<channel> in the tx block; the receiver clears it.
  "#mbox-cells":
    const: 1
mbox-cells:
  - channel
```

## dts/bindings/mfd/dlg,da9063.yaml
```yaml
# SPDX-License-Identifier: Apache-2.0
description: DA9063 PMIC
compatible: "dlg,da9063"
include: i2c-device.yaml
properties:
  timeout-counter:
    type: phandle
    required: true
  upper-bank-address:
    type: int
    required: true
```

## dts/bindings/mfd/dlg,da9121.yaml
```yaml
# SPDX-License-Identifier: Apache-2.0
description: DA9121 PMIC
compatible: "dlg,da9121"
include: i2c-device.yaml
properties:
  timeout-counter:
    type: phandle
    required: true
```

## dts/bindings/mfd/dlg,slg51000.yaml
```yaml
# SPDX-License-Identifier: Apache-2.0
description: SLG51000 PMIC
compatible: "dlg,slg51000"
include: i2c-device.yaml
properties:
  timeout-counter:
    type: phandle
    required: true
```

## dts/bindings/mfd/silergy,sy70209.yaml
```yaml
# SPDX-License-Identifier: Apache-2.0
description: SY70209 PMIC
compatible: "silergy,sy70209"
include: i2c-device.yaml
properties:
  timeout-counter:
    type: phandle
    required: true
```

## dts/bindings/mfd/silergy,sy70300.yaml
```yaml
# SPDX-License-Identifier: Apache-2.0
description: SY70300 PMIC
compatible: "silergy,sy70300"
include: i2c-device.yaml
properties:
  timeout-counter:
    type: phandle
    required: true
```

## dts/bindings/pm/operating-points-v2.yaml
```yaml
# SPDX-License-Identifier: Apache-2.0
description: Operating points for a frequency and its required supply voltage
compatible: "operating-points-v2"
include: base.yaml
properties:
  opp-shared:
    type: boolean
child-binding:
  properties:
    opp-hz:
      type: array
      required: true
      description: Frequency in Hz, encoded as one 64-bit value
    opp-microvolt:
      type: array
      required: true
    clock-latency-ns:
      type: int
    turbo-mode:
      type: boolean
```

## dts/bindings/power-domain/zhihe,a210-power-domain.yaml
```yaml
# SPDX-License-Identifier: Apache-2.0
description: A210 peripheral power domain managed by E902
compatible: "zhihe,a210-power-domain"
include: [base.yaml, reset-device.yaml]
properties:
  reg:
    description: Domain PCU, BPC, optional PCA and IOPMP registers
  reg-names:
    type: string-array
  domain-id:
    type: int
    required: true
  domain-name:
    type: string
    required: true
  always-on:
    type: boolean
  zhihe,retain-context:
    type: boolean
    description: |
      Only gate the domain clocks on power-off. The domain resets are
      released on power-on but stay released afterwards, so controller
      registers survive a runtime power-off.
  timeout-counter:
    type: phandle
    required: true
  zhihe,clock-controller:
    type: phandle
    required: true
  zhihe,reset-controller:
    type: phandle
    required: true
  vin-supply:
    type: phandle
  zhihe,ccu-config:
    type: array
    description: |
      Per-CCU tuples of register base, delay, delay step, low-power mode
      (0 for gating or 1 for scaling), and low-power divider value.
  "#power-domain-cells":
    const: 0
power-domain-cells: []
```

## dts/bindings/power-domain/zhihe,a210-system-controller.yaml
```yaml
# SPDX-License-Identifier: Apache-2.0
description: A210 full-system shutdown and cold reset controller
compatible: "zhihe,a210-system-controller"
include: base.yaml
properties:
  reg:
    required: true
  reg-names:
    required: true
  pmic:
    type: phandle
    required: true
  timeout-counter:
    type: phandle
    required: true
```

## dts/bindings/regulator/dlg,da9063-regulator.yaml
```yaml
# SPDX-License-Identifier: Apache-2.0
description: DA9063 voltage output selected by the reg output identifier
compatible: "dlg,da9063-regulator"
include: [regulator.yaml, base.yaml]
properties:
  reg:
    required: true
  regulator-min-microvolt:
    required: true
  regulator-max-microvolt:
    required: true
  settling-time-us:
    type: int
    required: true
```

## dts/bindings/regulator/dlg,da9121-regulator.yaml
```yaml
# SPDX-License-Identifier: Apache-2.0
description: DA9121 voltage output selected by the reg output identifier
compatible: "dlg,da9121-regulator"
include: [regulator.yaml, base.yaml]
properties:
  reg:
    required: true
  regulator-min-microvolt:
    required: true
  regulator-max-microvolt:
    required: true
  settling-time-us:
    type: int
    required: true
```

## dts/bindings/regulator/dlg,slg51000-regulator.yaml
```yaml
# SPDX-License-Identifier: Apache-2.0
description: SLG51000 voltage output selected by the reg output identifier
compatible: "dlg,slg51000-regulator"
include: [regulator.yaml, base.yaml]
properties:
  reg:
    required: true
  regulator-min-microvolt:
    required: true
  regulator-max-microvolt:
    required: true
  settling-time-us:
    type: int
    required: true
  slg-high-range:
    type: boolean
```

## dts/bindings/regulator/silergy,sy70209-regulator.yaml
```yaml
# SPDX-License-Identifier: Apache-2.0
description: |
  SY70209 voltage output selected by the reg output identifier. Buck outputs
  use SY70209_BUCK(1)..SY70209_BUCK(8) and LDOs use SY70209_LDO(1)..
  SY70209_LDO(10), excluding LDO6, from zephyr/dt-bindings/regulator/sy70209.h.
  LDOs require equal minimum and maximum voltages for a fixed board policy.
compatible: "silergy,sy70209-regulator"
include: [regulator.yaml, base.yaml]
properties:
  reg:
    required: true
  regulator-min-microvolt:
    required: true
  regulator-max-microvolt:
    required: true
  settling-time-us:
    type: int
    required: true
```

## dts/bindings/regulator/silergy,sy70300-regulator.yaml
```yaml
# SPDX-License-Identifier: Apache-2.0
description: SY70300 voltage output selected by the reg output identifier
compatible: "silergy,sy70300-regulator"
include: [regulator.yaml, base.yaml]
properties:
  reg:
    required: true
  regulator-min-microvolt:
    required: true
  regulator-max-microvolt:
    required: true
  settling-time-us:
    type: int
    required: true
  enable-gpios:
    type: phandle-array
```

## dts/bindings/regulator/zephyr,regulator-coupled.yaml
```yaml
# SPDX-License-Identifier: Apache-2.0
description: |
  Regulator group with equal target voltages. Each member except the last
  must remain within the stated voltage difference relative to the last.
compatible: "zephyr,regulator-coupled"
include: [base.yaml, regulator.yaml]
properties:
  regulators:
    type: phandles
    required: true
  min-spread-microvolt:
    type: int
    required: true
  max-spread-microvolt:
    type: int
    required: true
  voltage-step-microvolt:
    type: int
    required: true
```

## dts/bindings/reset/zhihe,a210-reset.yaml
```yaml
# SPDX-License-Identifier: Apache-2.0
description: A210 AP reset banks managed by E902
compatible: "zhihe,a210-reset"
include: [base.yaml, reset-controller.yaml]
properties:
  reg:
    required: true
  gpu-status-reg:
    type: int
    required: true
  vo-status-reg:
    type: int
    required: true
  "#reset-cells":
    const: 1
reset-cells:
  - id
```

## dts/bindings/sensor/moortec,mr75203.yaml
```yaml
# SPDX-License-Identifier: Apache-2.0
description: Moortec MR75203 PVT monitor
compatible: "moortec,mr75203"
include: base.yaml
properties:
  reg:
    required: true
  reg-names:
    required: true
  clock-frequency:
    type: int
    required: true
  timeout-counter:
    type: phandle
    required: true
  moortec,ts-coeff-h:
    type: int
    default: 200000
  moortec,ts-coeff-g:
    type: int
    default: 60000
  moortec,ts-coeff-j:
    type: int
    default: -100
  moortec,ts-coeff-cal5:
    type: int
    default: 4094
```

## soc/thead/th1520/Kconfig.defconfig
```kconfig
# SPDX-License-Identifier: Apache-2.0
if SOC_TH1520
config NUM_IRQS
	default 64
config RISCV_PMP
	default n
config XIP
	default n
config RISCV_MCAUSE_EXCEPTION_MASK
	default 0x3ff
endif
```
