## soc/zhihe/a210/Kconfig
```kconfig
# SPDX-License-Identifier: Apache-2.0
config SOC_A210
	select RISCV
	select RISCV_PRIVILEGED
	select RISCV_HAS_CLIC
	select INCLUDE_RESET_VECTOR
	select GEN_IRQ_VECTOR_TABLE
	select SOC_RESET_HOOK
```

## soc/zhihe/a210/Kconfig.defconfig
```kconfig
# SPDX-License-Identifier: Apache-2.0
if SOC_A210
config NUM_IRQS
	default 141
config RISCV_PMP
	default n
config XIP
	default n
config RISCV_MCAUSE_EXCEPTION_MASK
	default 0x3ff
endif
```

## soc/zhihe/a210/Kconfig.soc
```kconfig
# SPDX-License-Identifier: Apache-2.0
config SOC_A210
	bool

config SOC
	default "a210" if SOC_A210
```

## subsys/mgmt/scmi/Kconfig
```kconfig
# SPDX-License-Identifier: Apache-2.0
config SCMI
	bool

menuconfig SCMI_SERVER
	bool "SCMI platform server"
	select SCMI
	help
	  Serve Base and optional Clock, Reset, Voltage and Performance requests.

if SCMI_SERVER

config SCMI_SERVER_VOLTAGE
	bool "Voltage Domain protocol"
	default y

config SCMI_SERVER_REGULATOR
	bool "Zephyr regulator provider"
	depends on SCMI_SERVER_VOLTAGE && REGULATOR
	default y

endif # SCMI_SERVER
```

## tests/drivers/mbox/e902/testcase.yaml
```yaml
tests:
  drivers.mbox.e902:
    tags: [mbox]
    platform_allow: [native_sim/native/64]
    integration_platforms: [native_sim/native/64]
```

## tests/drivers/regulator/hardware_status/testcase.yaml
```yaml
tests:
  drivers.regulator.hardware_status:
    tags: [regulator]
    platform_allow: [native_sim/native/64]
    integration_platforms: [native_sim/native/64]
```

## tests/drivers/regulator/pmic_build/testcase.yaml
```yaml
tests:
  drivers.regulator.pmic_build:
    build_only: true
    tags: [regulator]
    platform_allow: [milkv_meles/th1520/e902]
    integration_platforms: [milkv_meles/th1520/e902]
```

## tests/drivers/regulator/pmic_transport/testcase.yaml
```yaml
tests:
  drivers.regulator.pmic_transport:
    tags: [regulator, i2c]
    platform_allow: [native_sim/native/64]
    integration_platforms: [native_sim/native/64]
```

## tests/subsys/mgmt/scmi_regulator/testcase.yaml
```yaml
tests:
  subsys.mgmt.scmi_regulator:
    tags: [scmi, regulator]
    platform_allow: [native_sim/native/64]
    integration_platforms: [native_sim/native/64]
```

## tests/unit/a210_clock_tree/testcase.yaml
```yaml
# SPDX-License-Identifier: Apache-2.0
tests:
  clock.a210_tree:
    type: unit
    tags: clock_control
```

## tests/unit/cpu_dvfs/testcase.yaml
```yaml
# SPDX-License-Identifier: Apache-2.0
tests:
  clock_control.cpu_dvfs:
    type: unit
    tags: clock_control
```

## tests/unit/regulator_silergy/testcase.yaml
```yaml
tests:
  libraries.regulator_silergy:
    type: unit
    tags: [regulator_silergy]
```

## tests/unit/scmi_clock/testcase.yaml
```yaml
# SPDX-License-Identifier: Apache-2.0
tests:
  scmi.clock:
    type: unit
    tags: scmi
```

## tests/unit/scmi_performance/testcase.yaml
```yaml
# SPDX-License-Identifier: Apache-2.0
tests:
  scmi.performance:
    type: unit
    tags: scmi
```

## tests/unit/scmi_platform/testcase.yaml
```yaml
# SPDX-License-Identifier: Apache-2.0
tests:
  scmi.platform:
    type: unit
    tags: scmi
```

## tests/unit/scmi_power/testcase.yaml
```yaml
# SPDX-License-Identifier: Apache-2.0
tests:
  scmi.power:
    type: unit
    tags: scmi
```

## tests/unit/scmi_reset/testcase.yaml
```yaml
# SPDX-License-Identifier: Apache-2.0
tests:
  scmi.reset:
    type: unit
    tags: scmi
```

## tests/unit/xuantie_cpu_pll/testcase.yaml
```yaml
# SPDX-License-Identifier: Apache-2.0
tests:
  clock_control.xuantie_cpu_pll:
    type: unit
    tags: clock_control
```
